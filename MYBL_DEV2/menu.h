#ifndef MENU_BITMAPS_H
#define MENU_BITMAPS_H

#include "inputs.h"
#include "game.h"

//define menu states (on main menu)
#define STATE_MENU_INTRO         0
#define STATE_MENU_MAIN          1
#define STATE_MENU_HELP          2
#define STATE_MENU_PLAY          3
#define STATE_MENU_INFO          4
#define STATE_MENU_SOUNDFX       5

//define game states (on main menu)
#define STATE_GAME_PLAYING       6
#define STATE_GAME_PAUSE         7
#define STATE_GAME_OVER          8

extern byte gameState;

boolean soundYesNo;
int menuSelection;
byte counter = 0;
byte frames = 0;
byte blinkingFrame = 0;

const uint8_t PROGMEM TEAMarg[] = {
  //         ########                                                                                       ########
  //         ###########                                                                                   ##      ##
  //         ####    ##################                                                                   ##  #### ###
  //         #### ##    ################ ####################           #############         ######     ##  ##  # ####
  //         #### #####                #######################       ##################      ########   ##  ###  # #####
  //         #### ##  ######  ######## ##                   ###     ####            ####     ##     ## ##  ####### #  ###
  // ####### ####  #  ####### #####  #  # #################  ##    ###   ##########   ###   ##  ###  ###  ###  ### #   ### ##########
  //         ##### ##########  ####  ## #  ################# ##   ###  ##############   ##  ## #####  #  ###    ## ##  ###
  //         ##### ########### ######## #   ################  #   ##  #################  ####  ######   ####    ## ########
  // ##### # #####             ########     ################# #  ##  #######    ######## #### ######## ######  ### ########  # # ####
  // #  #    ###### ####################    ################# #  ## #######      #######  ##  #################### ########      #  #
  // #  # #  ###### ####################     #######          # ##  ######       ####  ## ## #################  ## ######## # #  #  #
  // ####    ######  #  ################     ##############   # ## #######       ####  ## #  #################  ## ########      ####
  // ####  # ####### #  #################  # ##############   ###  ######       ######### # ###################### ########  # # ####
  // ####    ####### ####################  # ###############  ### #######       ########    #####################  ########      ####
  // #### #   ######        #########      # ###############  ##  ######       #########   ###################### ######### # #  ####
  // ####     #####          ########     ##  ############## ### ######################    ###################### #########     #####
  // ##### #  #####          #########    ### ########        #  ######################   ####################### ########   #  #####
  // #####     ###            ########    ### ###############   ######################    ####################### ########      #####
  // ###### #  ###         #  #########  #### ################  #######      #########   ######## ############### ########  # # #####
  // ######    ##          #   ########  ####  ################  ######      ########    #######  ############### ########      #####
  // ####### #  #         ###  ######### ##### ################# #####       ########   ########   ###### ####### ######## # # ######
  // #######    #         ###   ########  #### #  ############## #####      ########    #######    #####  ####### ########     ######
  // ######## # ######## #####  ##  ##### #### #  ########                  ###  ###    #######     ###   ######  ########  #  ######
  // ########          # #####   #  ##### #### #####             #         ####  ##                 ##    ###  # #########     ######
  // #  ###### # # # # ########  #####    ####                ## #         ########           ##          ###  # ######### # # ###  #
  // #  ######          #######           ####                ## #     ###                     #            #### #########     ###  #
  // ########## # # # # #########         # ##                   #     ###             ##      ##             ## #########  # #######
  //                    ########         ## ##                   #    ####             ##       #                ########
  //         ###         #######         #  ##              ######    ####            ####      ##  #    #       ########
  // ######### ######    ######         ##   #       #####################            # ##       #  ##  ####      #######   #########
  //       ##   ##       ######         #    ################            ############## ######################     ######
  //      ##     ##   ## #####         ## ## #########                   ############    #######################    #####
  //     ## ##    ##  ##  ####         #  ##                                                  ##     #############   #### ##
  //     #  ##     #      ###         ##          ########    ##########      #########       ##     ##### #########  ### ##
  //     ##       ##      ###     #####          ##########   ###########    ###########           ######      ##########
  //      ##   # ##       #############         ############  ############   ###########          ####            #######   ###
  //       ##   ##   ###  ########  ####        ############  #####  #####  #####   ####       ## ####    ###               # #
  //        ## ##    # #            ####        #####   ####  #####   ####  ####               ##  ##     # #               ###
  //         ###     ###             ##         #####   ####  #####   ###   ####   ######                 ###
  //                                            ############  ##########    #####  ######
  //                                            ###########      ########      ########
  //                                            ########### #### ## ##### #### ######## ####
  //                                            #####   ### #  # ##  #### #  # ######## #  #
  //                                            #####   ### #### ##   ### #### ######## ####
  //
  //
  //
  0x40, 0x40, 0x40, 0x40, 0x40, 0x40, 0x40, 0x00, 0xFF, 0xFF, 0xFF, 0xFF,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 0x40,
  0xFE, 0xF2, 0xF2, 0xFE, 0x02, 0x88, 0x22, 0x00, 0x7F, 0xFF, 0xFF, 0xFF,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 0xFE,
  0xFF, 0xFF, 0xFF, 0xFF, 0xFE, 0xF8, 0xE2, 0x88, 0x20, 0x83, 0x1F, 0xFF,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 0xFF,
  0x4F, 0x49, 0x49, 0x4F, 0x4F, 0x4F, 0xCF, 0xCF, 0x6E, 0x28, 0x62, 0xC8,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 0x4F,
  0x00, 0x00, 0x00, 0x00, 0x0E, 0x1B, 0x31, 0x66, 0xC6, 0x80, 0xD0, 0x60,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 0x00,
  0x00, 0x00, 0x00, 0x00, 0x00, 0x00, 0x00, 0x00, 0x00, 0x00, 0x00, 0x00,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 0x00,
};

PROGMEM const unsigned char qrcode[] = {
  // width, height 64, 64,
  0xFF, 0xFF, 0xFF, 0x07, 0x07, 0xE7, 0xE7, 0x67, 0x67, 0x67, 0x67, 0x67,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 0xFF,
  0xFF, 0xFF, 0xFF, 0x00, 0x00, 0x7F, 0x7F, 0x60, 0x60, 0x60, 0x60, 0x60,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 0xFF,
  0xFF, 0xFF, 0xFF, 0x06, 0x06, 0x66, 0x66, 0x66, 0x66, 0xE6, 0xE6, 0x06,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 0xFF,
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  0xFF, 0xFF, 0xFF, 0xE0, 0xE0, 0xE7, 0xE7, 0xE6, 0xE6, 0xE6, 0xE6, 0xE6,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 0xFF
};


PROGMEM const unsigned char titleScreen[] = {
  // width, height 128, 64,
  0xFF, 0xFF, 0xFE, 0xF8, 0xE0, 0xC0, 0x8F, 0xFF, 0x7F, 0x7F, 0x3F, 0x3F,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 0xFF,
  0x07, 0x07, 0x03, 0x03, 0x01, 0x01, 0x00, 0x00, 0x00, 0x00, 0x00, 0x00,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 0x01,
  0x00, 0x00, 0x00, 0x00, 0x00, 0x00, 0x00, 0x00, 0x00, 0x00, 0x00, 0x00,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 0xFC,
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  0x80, 0x80, 0x80, 0xC0, 0xC0, 0xE1, 0xE1, 0xF3, 0xE7, 0xEF, 0xEC, 0xEC,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 0x00
};

PROGMEM const unsigned char mysticBalloon[] = {
  // width, height 42, 24,
  0xFE, 0x03, 0xF9, 0xFD, 0x0D, 0xFD, 0xF9, 0x0D, 0xFD, 0xF9, 0xC3, 0xD9,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 0xFE,
  0xFF, 0x00, 0x7E, 0x7E, 0x7A, 0x6E, 0x6C, 0x38, 0x00, 0x7C, 0x7E, 0x1A,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 0xFF,
  0x01, 0x03, 0x02, 0x02, 0x02, 0x02, 0x02, 0x02, 0x03, 0x02, 0x02, 0x02,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 0x01
};


PROGMEM const unsigned char mainMenu[] = {
  // width, height 27, 40,
  0x00, 0xFC, 0xFE, 0x02, 0xFA, 0x22, 0x22, 0xFA, 0x02, 0xFA, 0xAA, 0xAA, 0x8A, 0x02, 0xFA, 0x82, 0xBE, 0xBE, 0x02, 0xFA, 0x2A, 0xAA, 0xBA, 0x82, 0xFE, 0xFC, 0x00,
  0x00, 0xFF, 0xFF, 0x06, 0xF6, 0x56, 0x56, 0x76, 0x06, 0xF6, 0x06, 0x7E, 0x7E, 0x06, 0xF6, 0x96, 0x96, 0xF6, 0x06, 0x76, 0x46, 0xC7, 0x77, 0x07, 0xFF, 0xFF, 0x00,
  0x00, 0xFF, 0xFF, 0x0C, 0x2D, 0xEC, 0x2F, 0x0F, 0xEC, 0x4D, 0x8D, 0x0D, 0xED, 0x0C, 0xED, 0xAC, 0xAC, 0x2D, 0x0C, 0xEF, 0x2C, 0x2D, 0xEC, 0x0F, 0xFF, 0xFF, 0x00,
  0x00, 0xFF, 0xFF, 0x18, 0xDA, 0x5B, 0x5A, 0x18, 0x1B, 0xD8, 0x58, 0x59, 0xDB, 0x18, 0xDB, 0x98, 0x1E, 0xDE, 0x18, 0xDB, 0x5A, 0x5A, 0x5B, 0x18, 0xFF, 0xFF, 0x00,
  0x00, 0x0F, 0x1F, 0x10, 0x17, 0x14, 0x15, 0x15, 0x10, 0x17, 0x14, 0x14, 0x17, 0x10, 0x17, 0x10, 0x11, 0x17, 0x10, 0x17, 0x11, 0x1D, 0x1C, 0x1F, 0x1F, 0x0F, 0x00
};

PROGMEM const unsigned char mainMenuMask[] = {
  // width, height 27, 40,
  0xFE, 0xFF, 0xFF, 0xFF, 0xFF, 0xFF, 0xFF, 0xFF, 0xFF, 0xFF, 0xFF, 0xFF, 0xFF, 0xFF, 0xFF, 0xFF, 0xFF, 0xFF, 0xFF, 0xFF, 0xFF, 0xFF, 0xFF, 0xFF, 0xFF, 0xFF, 0xFE,
  0xFF, 0xFF, 0xFF, 0xFF, 0xFF, 0xFF, 0xFF, 0xFF, 0xFF, 0xFF, 0xFF, 0xFF, 0xFF, 0xFF, 0xFF, 0xFF, 0xFF, 0xFF, 0xFF, 0xFF, 0xFF, 0xFF, 0xFF, 0xFF, 0xFF, 0xFF, 0xFF,
  0xFF, 0xFF, 0xFF, 0xFF, 0xFF, 0xFF, 0xFF, 0xFF, 0xFF, 0xFF, 0xFF, 0xFF, 0xFF, 0xFF, 0xFF, 0xFF, 0xFF, 0xFF, 0xFF, 0xFF, 0xFF, 0xFF, 0xFF, 0xFF, 0xFF, 0xFF, 0xFF,
  0xFF, 0xFF, 0xFF, 0xFF, 0xFF, 0xFF, 0xFF, 0xFF, 0xFF, 0xFF, 0xFF, 0xFF, 0xFF, 0xFF, 0xFF, 0xFF, 0xFF, 0xFF, 0xFF, 0xFF, 0xFF, 0xFF, 0xFF, 0xFF, 0xFF, 0xFF, 0xFF,
  0x1F, 0x3F, 0x3F, 0x3F, 0x3F, 0x3F, 0x3F, 0x3F, 0x3F, 0x3F, 0x3F, 0x3F, 0x3F, 0x3F, 0x3F, 0x3F, 0x3F, 0x3F, 0x3F, 0x3F, 0x3F, 0x3F, 0x3F, 0x3F, 0x3F, 0x3F, 0x1F
};

PROGMEM const unsigned char soundMenu[] = {
  // width, height 35, 32,
  0x00, 0xFC, 0xFE, 0x02, 0xBA, 0xAA, 0xAA, 0xEA, 0x02, 0xFA, 0x2A, 0xAA,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 0x00,
  0x00, 0x01, 0x03, 0x02, 0x02, 0x02, 0x02, 0x02, 0x02, 0xFE, 0xFE, 0xFF,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 0x00,
  0x00, 0x00, 0x00, 0x00, 0x00, 0x00, 0x00, 0x00, 0x00, 0xFF, 0xFF, 0xFF,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 0x00,
  0x00, 0x00, 0x00, 0x00, 0x00, 0x00, 0x00, 0x00, 0x00, 0x07, 0x0F, 0x0F,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 0x00

};

PROGMEM const unsigned char soundMenuMask[] = {
  // width, height 35, 32,
  0xFE, 0xFF, 0xFF, 0xFF, 0xFF, 0xFF, 0xFF, 0xFF, 0xFF, 0xFF, 0xFF, 0xFF,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 0x00,
  0x03, 0x07, 0x07, 0x07, 0x07, 0x07, 0x07, 0x07, 0xFF, 0xFF, 0xFF, 0xFF,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 0xFC,
  0x00, 0x00, 0x00, 0x00, 0x00, 0x00, 0x00, 0x00, 0xFF, 0xFF, 0xFF, 0xFF,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 0xFF,
  0x00, 0x00, 0x00, 0x00, 0x00, 0x00, 0x00, 0x00, 0x0F, 0x1F, 0x1F, 0x1F,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 0x0F

};


PROGMEM const unsigned char selector[] = {
  // width, height 33, 16,
  0x00, 0xF0, 0xF8, 0xE8, 0xC8, 0xF0, 0x00, 0x02, 0x02, 0x02, 0x02, 0x02,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 0x00,
  0x00, 0x00, 0x01, 0x03, 0x01, 0x00, 0x02, 0x02, 0x02, 0x02, 0x02, 0x02,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 0x00
};


PROGMEM const unsigned char selectorMask[] = {
  // width, height 33, 16,
  0xF8, 0xFC, 0xFC, 0xFC, 0xFC, 0xFC, 0xFB, 0x03, 0x03, 0x03, 0x03, 0x03,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 0xFE,
  0x01, 0x03, 0x07, 0x7F, 0x07, 0x07, 0x0F, 0x0E, 0x0E, 0x0E, 0x0E, 0x0E,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 0x07
};



PROGMEM const unsigned char stars[] = {
  // width, height
  7, 16,
  // frame 0
  0x00, 0x10, 0x38, 0x90, 0x00, 0x04, 0x06,
  0x00, 0x00, 0x01, 0x03, 0x01, 0x00, 0x00,
  // frame 1
  0x10, 0x10, 0x7C, 0x10, 0x10, 0x00, 0x1C,
  0x00, 0x00, 0x00, 0x00, 0x00, 0x00, 0x00,
  // frame 2
  0x00, 0x10, 0x38, 0x10, 0x00, 0x04, 0x0E,
  0x00, 0x00, 0x00, 0x01, 0x00, 0x00, 0x00,
  // frame 3
  0x00, 0x00, 0x00, 0x80, 0x04, 0x04, 0x07,
  0x00, 0x00, 0x01, 0x03, 0x01, 0x00, 0x00,
  // frame 4
  0x00, 0x00, 0x90, 0xC0, 0x84, 0x0E, 0x07,
  0x00, 0x01, 0x03, 0x07, 0x03, 0x01, 0x00,
};

PROGMEM const byte blinkingEyesLeftGuy[] = {0, 0, 0, 0, 0, 1, 2, 3, 4, 4, 4, 1};
PROGMEM const byte blinkingEyesRightGuy[] = {0, 0, 0, 1, 0, 2, 3, 3, 2, 0, 0, 0};


PROGMEM const unsigned char leftGuyLeftEye[] = {
  // width, height
  5, 8,
  // frame 0
  0x06, 0x0E, 0x0E, 0x0C, 0x00,
  // frame 1
  0x02, 0x06, 0x0E, 0x0C, 0x00,
  // frame 2
  0x06, 0x0F, 0x0F, 0x07, 0x03,
  // frame 3
  0x03, 0x06, 0x0C, 0x00, 0x00,
  // frame 4
  0x00, 0x00, 0x00, 0x00, 0x00,
};

PROGMEM const unsigned char leftGuyRightEye[] = {
  // width, height
  6, 8,
  // frame 0
  0x00, 0x1C, 0x1E, 0x1E, 0x0E, 0x00,
  // frame 1
  0x00, 0x0C, 0x1E, 0x1E, 0x0C, 0x00,
  // frame 2
  0x00, 0x1C, 0x1E, 0x1F, 0x0F, 0x06,
  // frame 3
  0x04, 0x0C, 0x18, 0x10, 0x00, 0x00,
  // frame 4
  0x00, 0x00, 0x00, 0x00, 0x00, 0x00,
};

PROGMEM const unsigned char rightGuyEyes[] = {
  // width, height
  16, 8,
  // frame 0
  0x20, 0x60, 0x60, 0x60, 0x60, 0x40, 0x00, 0x00, 0x00, 0x00, 0x00, 0x18, 0x1C, 0x0E, 0x07, 0x03,
  // frame 1
  0x30, 0x70, 0x70, 0x70, 0x70, 0x60, 0x00, 0x00, 0x00, 0x00, 0x00, 0x1C, 0x1E, 0x0F, 0x07, 0x03,
  // frame 2
  0x40, 0x40, 0x40, 0x40, 0x40, 0x40, 0x00, 0x00, 0x00, 0x00, 0x00, 0x10, 0x08, 0x04, 0x02, 0x01,
  // frame 3
  0x00, 0x00, 0x00, 0x00, 0x00, 0x00, 0x00, 0x00, 0x00, 0x00, 0x00, 0x00, 0x00, 0x00, 0x00, 0x00,
};


void drawTitleScreen()
{
  if (arduboy.everyXFrames(2))
  {
    frames++;
    blinkingFrame++;
  }
  if (frames > 4) frames = 0;
  if (blinkingFrame > 11) blinkingFrame = 0;
  arduboy.drawBitmap(0, 0, titleScreen, 128, 64, WHITE);
  arduboy.drawBitmap(85, 45, mysticBalloon, 42, 24, WHITE);
  sprites.drawSelfMasked(79, 43, stars, frames);
  sprites.drawSelfMasked(9, 9, leftGuyLeftEye, pgm_read_byte(&blinkingEyesLeftGuy[blinkingFrame]));
  //sprites.drawSelfMasked(15, 13, leftGuyRightEye, pgm_read_byte(&blinkingEyesLeftGuy[blinkingFrame]));
  sprites.drawSelfMasked(109, 34, rightGuyEyes, pgm_read_byte(&blinkingEyesRightGuy[blinkingFrame]));
}

void stateMenuIntro()
{
  counter++;
  if (counter < 181) arduboy.drawBitmap(0, 8, TEAMarg, 128, 48, WHITE);
  if (counter > 180) drawTitleScreen();
  if ((counter > 254) || buttons.justPressed(A_BUTTON | B_BUTTON)) gameState = STATE_MENU_MAIN;
}

void stateMenuMain()
{
  drawTitleScreen();
  arduboy.drawBitmap(51, 9, mainMenuMask, 27, 40, BLACK);
  arduboy.drawBitmap(51, 9, mainMenu, 27, 40, WHITE);
  arduboy.drawBitmap(46, 9 + 9 * (menuSelection - 2), selectorMask, 33, 16, BLACK);
  arduboy.drawBitmap(46, 9 + 9 * (menuSelection - 2), selector, 33, 16, WHITE);
  if (buttons.justPressed(DOWN_BUTTON) && (menuSelection < 5)) menuSelection++;
  if (buttons.justPressed(UP_BUTTON) && (menuSelection > 2)) menuSelection--;
  if (buttons.justPressed(A_BUTTON | B_BUTTON)) gameState = menuSelection;
}

void stateMenuHelp()
{
  arduboy.drawBitmap(32, 0, qrcode, 64, 64, WHITE);
  if (buttons.justPressed(A_BUTTON | B_BUTTON)) gameState = STATE_MENU_MAIN;
}

void stateMenuPlay()
{
  gameState = STATE_GAME_PLAYING;
}

void stateMenuInfo()
{
  if (arduboy.everyXFrames(10)) frames++;
  if (frames > 4) frames = 0;
  arduboy.drawBitmap(43, 23, mysticBalloon, 42, 24, WHITE);
  sprites.drawSelfMasked(37, 21, stars, frames);
  if (buttons.justPressed(A_BUTTON | B_BUTTON)) gameState = STATE_MENU_MAIN;
}

void stateMenuSoundfx()
{
  drawTitleScreen();
  arduboy.drawBitmap(51, 9, soundMenuMask, 35, 32, BLACK);
  arduboy.drawBitmap(51, 9, soundMenu, 35, 32, WHITE);
  arduboy.drawBitmap(54, 18 + 9 * soundYesNo, selectorMask, 33, 16, BLACK);
  arduboy.drawBitmap(54, 18 + 9 * soundYesNo, selector, 33, 16, WHITE);
  if (buttons.justPressed(DOWN_BUTTON)) soundYesNo = true;
  if (buttons.justPressed(UP_BUTTON)) soundYesNo = false;
  if (buttons.justPressed(A_BUTTON | B_BUTTON))
  {
    arduboy.audio.save_on_off();
    gameState = STATE_MENU_MAIN;
  }
  if (soundYesNo == true) arduboy.audio.on();
  else arduboy.audio.off();
}


#endif
